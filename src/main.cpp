#include <Arduino.h>
#include <WiFi.h>
#include <string>
#include "ServoWebServer.hpp"
#include "CameraWebServer.hpp"
#include "CameraReader.hpp"
#include "ServoWrapper.hpp"

char BMP_1[] = {0x42,0x4D,0x36,0x03,0x00,0x00,0x00,0x00,0x00,0x00,0x36,0x00,0x00,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0xFF,0xFF};
char BMP_2[] = {0x42,0x4D,0x36,0x03,0x00,0x00,0x00,0x00,0x00,0x00,0x36,0x00,0x00,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0xFF,0xFF};
char BMP_3[] = {0x42,0x4D,0x36,0x03,0x00,0x00,0x00,0x00,0x00,0x00,0x36,0x00,0x00,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0xFF,0xFF};

const char* ssid = "MakerRover";
const char* password = "makerrover";

CameraWebServer * cameraWebServer;
ServoWebServer * servoWebServer;

CameraReader * cameraReader;

ServoWrapper servoA(14);
ServoWrapper servoB(15);

const int ledPin = 4;

void setup() {
  Serial.begin(115200);

    delay(500);

    pinMode(ledPin, OUTPUT);

    // Connect to Wi-Fi network with SSID and password
    Serial.print("Connecting to ");
    Serial.println(ssid);
    WiFi.begin(ssid, password);
    while (WiFi.status() != WL_CONNECTED) {
        delay(500);
        Serial.print(".");
    }

    // Print local IP address and start web server
    Serial.println("");
    Serial.println("WiFi connected.");
    Serial.println("IP address: ");
    Serial.println(WiFi.localIP());

    servoWebServer = new ServoWebServer(81, servoA, servoB);
    cameraWebServer = new CameraWebServer(80);

    cameraReader = new CameraReader();
}

int i = 0;
long _lastSendTime = millis();
const long TimeBetweenSend = 100;
void loop() {
    servoA.Update();
    servoB.Update();

    servoWebServer->UpdateServo();
    cameraWebServer->Update();


    if(cameraReader->IsRunning() && cameraReader->HasNewFrame() && _lastSendTime + TimeBetweenSend < millis()){
        char * frame = nullptr;
        int length = cameraReader->GetFrame(frame);
        cameraWebServer->SendToAllClientsWithPage("image/jpeg", "/stream", frame, length);
        delete[] frame;

        _lastSendTime = millis();
    }

    if(i == 100){
        cameraWebServer->SendToAllClientsWithPage("image/bmp", "/streamdemo", BMP_1, sizeof(BMP_1));
    }
    if(i == 200){
        cameraWebServer->SendToAllClientsWithPage("image/bmp", "/streamdemo", BMP_2, sizeof(BMP_2));
    }
    if(i == 300){
        cameraWebServer->SendToAllClientsWithPage("image/bmp", "/streamdemo", BMP_3, sizeof(BMP_3));
        i = 0;
    }
    GlobalVars::Uptime = millis();

    if(i==0){
        digitalWrite(ledPin, HIGH);
    }else{
        digitalWrite(ledPin, LOW);
    }

    delay(10);
    i++;
}