#pragma once

#include <Arduino.h>
#include <WiFi.h>
#include <string>
#include "GlobalVars.hpp"

#define TIMEOUTMS 2000
#define DEBUG

char ICON_BMP_1[] = {0x42,0x4D,0x36,0x03,0x00,0x00,0x00,0x00,0x00,0x00,0x36,0x00,0x00,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0xFF,0xFF};
char Page_Home []  = "<html><head><title>ESP32 Webserver</title></head><body><h1>Welcome!</h1><a href=\"./stream\">Stream</a><br/><a href=\"./streamdemo\">Demo</a><hr/>{0}</body></html>";
char Page_404 []  = "<html><head><title>ESP32 Webserver - 404 not found</title></head><body><h1>404</h1><p>Page not found</p></body></html>";
char Stream_separator[] = "MYHTTPBOUNDARY";

class WebClient{
    public:
        WebClient(WiFiClient client);
        void Update();
        void Disconnect();
        bool IsConnected();
        String GetRequestedPage();
        void SendStream(String contentType, char * body, int size);

        void SendBody(String body);
        void SendBody(char * body, int length);

    private:
        WiFiClient _client;
        unsigned long _connectTime;
        String headerBuffer = "";
        String bodyBuffer = "";
        String requestPage = "";
        bool httpRequestRead = false;
        bool responseProcessed = false;
        bool httpRequestHeaderRead = false;
        bool httpRequestBodyRead = false;

        void ProcessRequest();
        void ProcessResponse();
        bool ReadHTTPRequest();
        void ProcessHTTPRequestHeader();

        void SendHeader(int responseCode, String contentType, bool connectionClose);

};

WebClient::WebClient(WiFiClient client) : _client(client){
    _connectTime = millis();
}

String WebClient::GetRequestedPage(){
    return requestPage;
}

bool WebClient::IsConnected(){
    return  _client.connected();
}

void WebClient::Update(){
    if(!httpRequestRead){
        ProcessRequest();
        return;
    }else if(!responseProcessed){
        ProcessResponse();
        responseProcessed = true;
    }
}
void WebClient::ProcessResponse(){
#ifdef DEBUG
    Serial.print("Page: ");
    Serial.println(requestPage);
#endif
    if(requestPage.equals("/")){
        SendHeader(200, "text/html", false);
        String body(Page_Home);
        body.replace("{0}", GlobalVars::StatsToHTML());
        SendBody(body);
        Disconnect();    
        return;    
    }
    if(requestPage.equals("/icon")){
        SendHeader(200, "image/bmp", false);
        SendBody(ICON_BMP_1, sizeof(ICON_BMP_1));
        Disconnect();    
        return;    
    }
    if(requestPage.equals("/stream")){
        SendHeader(200, "multipart/x-mixed-replace", true);
        return;
    }
    if(requestPage.equals("/streamdemo")){
        SendHeader(200, "multipart/x-mixed-replace", true);
        return;
    }
    if(requestPage.startsWith("/servo/")){
        SendHeader(200, "text/html", false);
        return;
    }

    SendHeader(404, "text/html", false);
    SendBody(Page_404);
    Disconnect();
}

void WebClient::ProcessRequest(){
    if(!httpRequestRead && !ReadHTTPRequest()){
        if(_connectTime + TIMEOUTMS < millis()){
#ifdef DEBUG
            Serial.println("Client timed out");
            Serial.flush();
#endif
            _client.stop();
        }
        return;
    }
}

bool WebClient::ReadHTTPRequest(){
    while(_client.available()){
        if(!httpRequestHeaderRead){      
            headerBuffer.concat((char)_client.read());
            if(headerBuffer.endsWith("\r\n\r\n") || headerBuffer.endsWith("\n\n") || headerBuffer.endsWith("\r\r")){
    #ifdef DEBUG
                Serial.println("Request head completed");
                Serial.print("headerBuffer: ");
                Serial.println(headerBuffer);
                Serial.flush();
    #endif
                httpRequestHeaderRead = true;
                httpRequestRead = true;
                ProcessHTTPRequestHeader();
                return true;
            }
        }

    } 
    return false;
}

void WebClient::ProcessHTTPRequestHeader(){
    int pageStart = headerBuffer.indexOf('/');
    int pageEnd = headerBuffer.indexOf(' ', pageStart);
    requestPage = headerBuffer.substring(pageStart, pageEnd);
    requestPage.toLowerCase();
}

void WebClient::Disconnect(){
#ifdef DEBUG
    Serial.println("Client disconnecting");
    Serial.flush();
#endif
    _client.flush();
    _client.stop();
}

void WebClient::SendHeader(int responseCode, String contentType, bool isMultipart){
    String response = "HTTP/1.1 " + String(responseCode) + " OK\r\n";
    if(!isMultipart){
        response += 
            "Content-Type: " + contentType + "\r\n" +
            "Connection: close\r\n";
    }else{
        response += 
            "Content-Type: multipart/x-mixed-replace; boundary=" + String(Stream_separator) + "\r\n" +
            "Connection: keep-alive\r\n";
    }
    response += "\r\n";

    _client.print(response);

    #ifdef DEBUG
        Serial.print("Sending header: ");
        Serial.println(response);
    #endif
}

void WebClient::SendBody(String body){
#ifdef DEBUG
    Serial.print("body length: ");
    Serial.println(sizeof(body));
#endif

    _client.print(body);
    _client.print("\r\n\r\n"); 
    _client.flush();

#ifdef DEBUG
        Serial.print("Sending body: ");
        Serial.println(body);
#endif
}

void WebClient::SendBody(char * body, int length){
#ifdef DEBUG
    Serial.print("body char length: ");
    Serial.println(length);
#endif

    _client.write(body, length);
    _client.print("\r\n\r\n"); 
    _client.flush();
}

void WebClient::SendStream(String contentType, char * body, int size){
    _client.print("--");
    _client.print(Stream_separator);
    _client.print("\r\n");
    _client.print(
        "Content-Type: " + contentType + "\r\n"+
        "\r\n");
    _client.write(body,size);

    _client.print("\r\n\r\n");
}
